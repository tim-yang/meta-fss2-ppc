## conf/layer.conf
```bitbake
# We have a conf and classes directory, add to BBPATH
BBPATH .= ":${LAYERDIR}"

# We have recipes-* directories, add to BBFILES
BBFILES += "${LAYERDIR}/recipes-*/*/*.bb \
	${LAYERDIR}/recipes-*/*/*.bbappend"

BBFILE_COLLECTIONS += "fss2-ppc"
BBFILE_PATTERN_fss2-ppc = "^${LAYERDIR}/"
BBFILE_PRIORITY_fss2-ppc = "7"
```

## conf/machine/t600.conf
```bitbake
#@TYPE: Machine
#@DESCRIPTION: Machine configuration for running T600 in 64-bit mode

require ../../../meta-fsl-ppc/conf/machine/e6500-64b.inc
require ../../../meta/conf/machine/include/soc-family.inc

SOC_FAMILY = "t2080"
# TODO: fix 32bit build of u-boot
UBOOT_MACHINES ?= "T2080QDS T2080QDS_SDCARD T2080QDS_SPIFLASH T2080QDS_NAND T2080QDS_SRIO_PCIE_BOOT"
KERNEL_DEVICETREE ?= "t2080qds.dtb t2080qds-usdpaa.dtb"
#KERNEL_DEFCONFIG ?= "${S}/arch/powerpc/configs/85xx/e6500rev2_defconfig"

JFFS2_ERASEBLOCK = "0x10000"

SERIAL_CONSOLES = "115200;ttyS0 115200;ttyS1 115200;ttyEHV0"
SERIAL_CONSOLES_CHECK = "${SERIAL_CONSOLES}"
USE_VT = "0"

BASELIB_powerpc64 = "lib"
```
